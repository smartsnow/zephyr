## CMakeLists.txt
```
# SPDX-License-Identifier: Apache-2.0

cmake_minimum_required(VERSION 3.13.1)
find_package(Zephyr REQUIRED HINTS $ENV{ZEPHYR_BASE})
project(central_cli)

FILE(GLOB app_sources src/*.c)
target_sources(app PRIVATE ${app_sources})

zephyr_library_include_directories(${ZEPHYR_BASE}/samples/bluetooth)
```

## prj.conf
```kconfig
CONFIG_BT=y
CONFIG_BT_DEBUG_LOG=y

# GAP
CONFIG_BT_CENTRAL=y

# SMP
CONFIG_BT_SMP=y

# GATT
CONFIG_BT_GATT_CLIENT=y

# ATT_MTU
CONFIG_BT_L2CAP_RX_MTU=247
CONFIG_BT_L2CAP_TX_MTU=247

# Enable UART interrupt
CONFIG_UART_INTERRUPT_DRIVEN=y
```

## src/main.c
```c
/* main.c - Application main entry point */

/*
 * Copyright (c) 2015-2016 Intel Corporation
 *
 * SPDX-License-Identifier: Apache-2.0
 */

#include <stdlib.h>

#include <zephyr/types.h>
#include <stddef.h>
#include <errno.h>
#include <zephyr.h>
#include <sys/printk.h>

#include <bluetooth/bluetooth.h>
#include <bluetooth/hci.h>
#include <bluetooth/conn.h>
#include <bluetooth/uuid.h>
#include <bluetooth/gatt.h>
#include <sys/byteorder.h>

#include <drivers/uart.h>

#include "ringbuf.h"

#define BT_LE_CONN_PARAM_FAST BT_LE_CONN_PARAM(6, 6, 0, 400)

#define BT_UUID_UART_VAL 0xFFF0
#define BT_UUID_UART_RX_VAL 0xFFF1
#define BT_UUID_UART_TX_VAL 0xFFF2

#define BT_UUID_UART BT_UUID_DECLARE_16(BT_UUID_UART_VAL)
#define BT_UUID_UART_RX BT_UUID_DECLARE_16(BT_UUID_UART_RX_VAL)
#define BT_UUID_UART_TX BT_UUID_DECLARE_16(BT_UUID_UART_TX_VAL)

typedef struct {
	const bt_addr_le_t *addr;
	int8_t rssi;
} scan_data_t;

static void start_scan(void);

static struct bt_conn *default_conn;

static uint16_t uart_rx_value_handle;

static struct bt_uuid_16 uuid = BT_UUID_INIT_16(0);
static struct bt_gatt_discover_params discover_params;
static struct bt_gatt_subscribe_params subscribe_params;

static uint16_t write_norsp_mtu;

static const struct device *uart_dev;
static ring_buffer_t uart_ring_buf;

static uint8_t notify_func(struct bt_conn *conn,
			   struct bt_gatt_subscribe_params *params,
			   const void *att_buf, uint16_t length)
{
	if (!att_buf) {
		printk("[UNSUBSCRIBED]\r\n");
		params->value_handle = 0U;
		return BT_GATT_ITER_STOP;
	}

	for (int i = 0; i < length; i++) {
		uart_poll_out(uart_dev, ((uint8_t *)att_buf)[i]);
	}

	return BT_GATT_ITER_CONTINUE;
}

static uint8_t discover_func(struct bt_conn *conn,
			     const struct bt_gatt_attr *attr,
			     struct bt_gatt_discover_params *params)
{
	int err;

	if (!attr) {
		printk("Discover complete\r\n");
		(void)memset(params, 0, sizeof(*params));
		return BT_GATT_ITER_STOP;
	}

	printk("[ATTRIBUTE] handle %u\r\n", attr->handle);

	if (!bt_uuid_cmp(discover_params.uuid, BT_UUID_UART)) {
		memcpy(&uuid, BT_UUID_UART_RX, sizeof(uuid));
		discover_params.uuid = &uuid.uuid;
		discover_params.start_handle = attr->handle + 1;
		discover_params.type = BT_GATT_DISCOVER_CHARACTERISTIC;

		printk("UART service start handle %u\r\n",
		       discover_params.start_handle);

		err = bt_gatt_discover(conn, &discover_params);
		if (err) {
			printk("Discover failed (err %d)\r\n", err);
		}
	} else if (!bt_uuid_cmp(discover_params.uuid, BT_UUID_UART_RX)) {
		memcpy(&uuid, BT_UUID_UART_TX, sizeof(uuid));
		discover_params.uuid = &uuid.uuid;

		uart_rx_value_handle = bt_gatt_attr_value_handle(attr);

		printk("UART Rx value handle %u\r\n", uart_rx_value_handle);

		err = bt_gatt_discover(conn, &discover_params);
		if (err) {
			printk("Discover failed (err %d)\r\n", err);
		}
	} else if (!bt_uuid_cmp(discover_params.uuid, BT_UUID_UART_TX)) {
		memcpy(&uuid, BT_UUID_GATT_CCC, sizeof(uuid));
		discover_params.uuid = &uuid.uuid;
		discover_params.start_handle = attr->handle + 2;
		discover_params.type = BT_GATT_DISCOVER_DESCRIPTOR;
		subscribe_params.value_handle = bt_gatt_attr_value_handle(attr);

		printk("UART Tx value handle %u\r\n",
		       subscribe_params.value_handle);

		err = bt_gatt_discover(conn, &discover_params);
		if (err) {
			printk("Discover failed (err %d)\r\n", err);
		}
	} else {
		subscribe_params.notify = notify_func;
		subscribe_params.value = BT_GATT_CCC_NOTIFY;
		subscribe_params.ccc_handle = attr->handle;

		printk("UART Tx CCC handle %u\r\n",
		       subscribe_params.ccc_handle);

		err = bt_gatt_subscribe(conn, &subscribe_params);
		if (err && err != -EALREADY) {
			printk("Subscribe failed (err %d)\r\n", err);
		} else {
			printk("Listen on UART Tx notification\r\n");
			printk("\033[7m\r\n");
			printk("+--------------------------------------------------------------+\r\n");
			printk("|   Shell@GATT by Snow Yang built at " __DATE__
			       " " __TIME__ "      |\r\n");
			printk("+--------------------------------------------------------------+\r\n");
			printk("\033[0m\r\n");
			uart_poll_out(uart_dev, '$');
			uart_poll_out(uart_dev, ' ');
		}

		return BT_GATT_ITER_STOP;
	}

	return BT_GATT_ITER_STOP;
}

static bool eir_found(struct bt_data *data, void *user_data)
{
	scan_data_t *scan_data = user_data;
	const bt_addr_le_t *addr = scan_data->addr;
	int8_t rssi = scan_data->rssi;
	int i;

	switch (data->type) {
	case BT_DATA_UUID16_SOME:
	case BT_DATA_UUID16_ALL:
		if (data->data_len % sizeof(uint16_t) != 0U) {
			printk("AD malformed\r\n");
			return true;
		}

		for (i = 0; i < data->data_len; i += sizeof(uint16_t)) {
			struct bt_uuid *uuid;
			uint16_t u16;
			int err;

			memcpy(&u16, &data->data[i], sizeof(u16));
			uuid = BT_UUID_DECLARE_16(sys_le16_to_cpu(u16));
			if (bt_uuid_cmp(uuid, BT_UUID_MESH_PROV) &&
			    bt_uuid_cmp(uuid, BT_UUID_MESH_PROXY)) {
				continue;
			}

			char addr_str[BT_ADDR_LE_STR_LEN];
			bt_addr_le_to_str(addr, addr_str, sizeof(addr_str));
			printk("Device found: %s (RSSI %d)\r\n", addr_str,
			       rssi);

			/* connect only to devices in close proximity */
			if (rssi < -30) {
				return true;
			}

			err = bt_le_scan_stop();
			if (err) {
				printk("Stop LE scan failed (err %d)\r\n", err);
				continue;
			}

			printk("Connecting ...\r\n");
			err = bt_conn_le_create(addr, BT_CONN_LE_CREATE_CONN,
						BT_LE_CONN_PARAM_FAST,
						&default_conn);
			if (err) {
				printk("Create conn failed (err %d)\r\n", err);
				start_scan();
			}

			return false;
		}
	}

	return true;
}

static void device_found(const bt_addr_le_t *addr, int8_t rssi, uint8_t type,
			 struct net_buf_simple *ad)
{
	if (default_conn) {
		return;
	}

	/* We're only interested in connectable events */
	if (type == BT_GAP_ADV_TYPE_ADV_IND ||
	    type == BT_GAP_ADV_TYPE_ADV_DIRECT_IND) {
		scan_data_t scan_data = {
			.addr = addr,
			.rssi = rssi,
		};
		bt_data_parse(ad, eir_found, &scan_data);
	}
}

static void start_scan(void)
{
	int err;

	/* Use active scanning and disable duplicate filtering to handle any
	 * devices that might update their advertising att_buf at runtime. */
	struct bt_le_scan_param scan_param = {
		.type = BT_LE_SCAN_TYPE_ACTIVE,
		.options = BT_LE_SCAN_OPT_NONE,
		.interval = BT_GAP_SCAN_FAST_INTERVAL,
		.window = BT_GAP_SCAN_FAST_WINDOW,
	};

	err = bt_le_scan_start(&scan_param, device_found);
	if (err) {
		printk("Scanning failed to start (err %d)\r\n", err);
		return;
	}

	printk("Scanning successfully started\r\n");
}

static void exchange_func(struct bt_conn *conn, uint8_t err,
			  struct bt_gatt_exchange_params *params)
{
	printk("Exchange %s\r\n", err == 0U ? "successful" : "failed");
	if (err == 0) {
		uint8_t att_mtu = bt_gatt_get_mtu(conn);
		write_norsp_mtu = att_mtu - 3;
		printk("MTU %d\r\n", att_mtu);

		memcpy(&uuid, BT_UUID_UART, sizeof(uuid));
		discover_params.uuid = &uuid.uuid;
		discover_params.func = discover_func;
		discover_params.start_handle = 0x0001;
		discover_params.end_handle = 0xffff;
		discover_params.type = BT_GATT_DISCOVER_PRIMARY;

		err = bt_gatt_discover(default_conn, &discover_params);
		if (err) {
			printk("Discover failed(err %d)\r\n", err);
			return;
		}
	}
}

static struct bt_gatt_exchange_params exchange_params = {
	.func = exchange_func,
};

static void connected(struct bt_conn *conn, uint8_t conn_err)
{
	char addr[BT_ADDR_LE_STR_LEN];
	int err;

	bt_addr_le_to_str(bt_conn_get_dst(conn), addr, sizeof(addr));

	if (conn_err) {
		printk("Failed to connect to %s (%u)\r\n", addr, conn_err);

		bt_conn_unref(default_conn);
		default_conn = NULL;

		start_scan();
		return;
	}

	printk("Connected: %s\r\n", addr);

	if (conn == default_conn) {
		err = bt_gatt_exchange_mtu(default_conn, &exchange_params);
		if (err) {
			printk("Exchange failed (err %d)\r\n", err);
		} else {
			printk("Exchange pending\r\n");
		}
	}
}

static void disconnected(struct bt_conn *conn, uint8_t reason)
{
	char addr[BT_ADDR_LE_STR_LEN];

	bt_addr_le_to_str(bt_conn_get_dst(conn), addr, sizeof(addr));

	printk("Disconnected: %s (reason 0x%02x)\r\n", addr, reason);

	if (default_conn != conn) {
		return;
	}

	bt_conn_unref(default_conn);
	default_conn = NULL;

	start_scan();
}

static struct bt_conn_cb conn_callbacks = {
	.connected = connected,
	.disconnected = disconnected,
};

static void cli_uart_flush(const struct device *dev)
{
	uint8_t c;
	while (uart_fifo_read(dev, &c, 1) > 0) {
		continue;
	}
}

static void cli_uart_isr(const struct device *uart, void *user_data)
{
	uint8_t c;
	int rx = 0;

	/* get all of the data off UART as fast as we can */
	while (uart_irq_update(uart) && uart_irq_rx_ready(uart)) {
		rx = uart_fifo_read(uart, &c, sizeof(c));
		if (rx <= 0) {
			continue;
		}

		ring_buffer_write(&uart_ring_buf, &c, 1);
	}
}

void main(void)
{
	int err = bt_enable(NULL);
	if (err) {
		printk("Bluetooth init failed (err %d)\r\n", err);
		return;
	}

	printk("Bluetooth initialized\r\n");

	bt_conn_cb_register(&conn_callbacks);

	start_scan();

	static uint8_t data_buffer[1024];
	ring_buffer_init(&uart_ring_buf, data_buffer, sizeof(data_buffer));

	uart_dev = device_get_binding(CONFIG_UART_CONSOLE_ON_DEV_NAME);
	uart_irq_rx_disable(uart_dev);
	uart_irq_tx_disable(uart_dev);
	cli_uart_flush(uart_dev);
	uart_irq_callback_set(uart_dev, cli_uart_isr);
	uart_irq_rx_enable(uart_dev);

	uint32_t read_len;
	static uint8_t att_buf[512];
	while (1) {
		k_sleep(K_MSEC(10));

		if (ring_buffer_used_space(&uart_ring_buf) == 0)
			continue;

		do {
			ring_buffer_read(&uart_ring_buf, att_buf,
					 write_norsp_mtu, &read_len);
			bt_gatt_write_without_response(default_conn,
						       uart_rx_value_handle,
						       att_buf, read_len,
						       false);
		} while (write_norsp_mtu == read_len);
	}
}
```

## src/ringbuf.c
```c
/**
 ******************************************************************************
 * @file    ringbuf.c
 * @author  swyang
 * @version V1.0.0
 * @date    18-July-2017
 * @brief   This file provide the ringbuffer functions.
 ******************************************************************************
 *
 *  UNPUBLISHED PROPRIETARY SOURCE CODE
 *  Copyright (c) 2017 MXCHIP Inc.
 *
 *  The contents of this file may not be disclosed to third parties, copied or
 *  duplicated in any form, in whole or in part, without the prior written
 *  permission of MXCHIP Corporation.
 ******************************************************************************
 */

#include <string.h>
#include "ringbuf.h"

int ring_buffer_init( ring_buffer_t* ring_buffer, uint8_t* buffer, uint32_t size )
{
  if (ring_buffer)
  {
    ring_buffer->buffer = (uint8_t*)buffer;
    ring_buffer->size   = size;
    ring_buffer->head   = 0;
    ring_buffer->tail   = 0;
    return 0;
  }
  else
    return -1;
}

int ring_buffer_deinit( ring_buffer_t* ring_buffer )
{
  //UNUSED_PARAMETER(ring_buffer);
  return 0;
}

uint32_t ring_buffer_free_space( ring_buffer_t* ring_buffer )
{
  uint32_t tail_to_end = ring_buffer->size-1 - ring_buffer->tail;
  return ((tail_to_end + ring_buffer->head) % ring_buffer->size);
}

uint32_t ring_buffer_used_space( ring_buffer_t* ring_buffer )
{
  uint32_t head_to_end = ring_buffer->size - ring_buffer->head;
  return ((head_to_end + ring_buffer->tail) % ring_buffer->size);
}

int ring_buffer_get_data( ring_buffer_t* ring_buffer, uint8_t** data, uint32_t* contiguous_bytes )
{
  uint32_t head_to_end = ring_buffer->size - ring_buffer->head;
  
  *data = &ring_buffer->buffer[ring_buffer->head];
  *contiguous_bytes = MIN(head_to_end, (head_to_end + ring_buffer->tail) % ring_buffer->size);
  
  return 0;
}

int ring_buffer_consume( ring_buffer_t* ring_buffer, uint32_t bytes_consumed )
{
  ring_buffer->head = (ring_buffer->head + bytes_consumed) % ring_buffer->size;
  return 0;
}

uint32_t ring_buffer_write( ring_buffer_t* ring_buffer, const uint8_t* data, uint32_t data_length )
{
  uint32_t tail_to_end = ring_buffer->size-1 - ring_buffer->tail;
  
  /* Calculate the maximum amount we can copy */
  uint32_t amount_to_copy = MIN(data_length, (tail_to_end + ring_buffer->head) % ring_buffer->size);

  /* Fix the bug when tail is at the end of buffer */
  tail_to_end++;
  
  /* Copy as much as we can until we fall off the end of the buffer */
  memcpy(&ring_buffer->buffer[ring_buffer->tail], data, MIN(amount_to_copy, tail_to_end));
  
  /* Check if we have more to copy to the front of the buffer */
  if ( tail_to_end < amount_to_copy )
  {
    memcpy( &ring_buffer->buffer[ 0 ], data + tail_to_end, amount_to_copy - tail_to_end );
  }
  
  /* Update the tail */
  ring_buffer->tail = (ring_buffer->tail + amount_to_copy) % ring_buffer->size;
  
  return amount_to_copy;
}

int ring_buffer_read( ring_buffer_t* ring_buffer, uint8_t* data, uint32_t data_length, uint32_t* number_of_bytes_read )
{
  uint32_t max_bytes_to_read;
  uint32_t i;
  uint32_t head;
  
  head = ring_buffer->head;
  
  max_bytes_to_read = MIN(data_length, ring_buffer_used_space(ring_buffer));
  
  if ( max_bytes_to_read != 0 )
  {
    for ( i = 0; i != max_bytes_to_read; i++, ( head = ( head + 1 ) % ring_buffer->size ) )
    {
      data[ i ] = ring_buffer->buffer[ head ];
    }
    
    ring_buffer_consume( ring_buffer, max_bytes_to_read );
  }
  
  *number_of_bytes_read = max_bytes_to_read;
  
  return 0;
}

uint8_t ring_buffer_is_full(ring_buffer_t *ring_buffer)
{
    if (ring_buffer_used_space(ring_buffer) >= ring_buffer->size - 1)
        return 1;
    else
        return 0;
}

uint32_t ring_buffer_total_size(ring_buffer_t *ring_buffer)
{
  return ring_buffer->size - 1;
}
```

## src/ringbuf.h
```c
/**
 ******************************************************************************
 * @file    ringbuf.h
 * @author  swyang
 * @version V1.0.0
 * @date    18-July-2017
 * @brief   Header file for ringbuf.c
 ******************************************************************************
 *
 *  UNPUBLISHED PROPRIETARY SOURCE CODE
 *  Copyright (c) 2017 MXCHIP Inc.
 *
 *  The contents of this file may not be disclosed to third parties, copied or
 *  duplicated in any form, in whole or in part, without the prior written
 *  permission of MXCHIP Corporation.
 ******************************************************************************
 */


#ifndef __RingBufferUtils_h__
#define __RingBufferUtils_h__

#include <stdint.h>

/** @addtogroup MICO_Middleware_Interface
  * @{
  */

/** @defgroup MICO_RingBuffer MiCO Ring Buffer
  * @brief Provide APIs for Ring Buffer
  * @{
  */

typedef struct
{
  uint8_t*  buffer;
  uint32_t  size;
  volatile uint32_t  head; /* Read from */
  volatile uint32_t  tail; /* Write to */
} ring_buffer_t;

#ifndef MIN
#define MIN(x,y)  ((x) < (y) ? (x) : (y))
#endif /* ifndef MIN */

/**
 * @brief ?
 *
 * @param ring_buffer:   ?
 * @param      buffer:   ?
 * @param        size:   ?
 *
 * @return   kNoErr        : on success.
 * @return   kGeneralErr   : if an error occurred
 */
int ring_buffer_init( ring_buffer_t* ring_buffer, uint8_t* buffer, uint32_t size );


/**
 * @brief ?
 *
 * @param ring_buffer:   ?
 *
 * @return   kNoErr        : on success.
 * @return   kGeneralErr   : if an error occurred
 */
int ring_buffer_deinit( ring_buffer_t* ring_buffer );


/**
 * @brief ?
 *
 * @param ring_buffer:   ?
 *
 * @return   
 */
uint32_t ring_buffer_free_space( ring_buffer_t* ring_buffer );


/**
 * @brief ?
 *
 * @param ring_buffer:   ?
 *
 * @return   
 */
uint32_t ring_buffer_used_space( ring_buffer_t* ring_buffer );


/**
 * @brief ?
 *
 * @param ring_buffer:   ?
 * @param data:   ?
 * @param contiguous_bytes: ?
 *
 * @return   
 */
int ring_buffer_get_data( ring_buffer_t* ring_buffer, uint8_t** data, uint32_t* contiguous_bytes );


/**
 * @brief ?
 *
 * @param ring_buffer:      ?
 * @param bytes_consumed:   ?
 *
 * @return   
 */
int ring_buffer_consume( ring_buffer_t* ring_buffer, uint32_t bytes_consumed );



/**
 * @brief ?
 *
 * @param ring_buffer:   ?
 * @param data:   ?
 * @param data_length: ?
 *
 * @return   
 */
uint32_t ring_buffer_write( ring_buffer_t* ring_buffer, const uint8_t* data, uint32_t data_length );

uint8_t ring_buffer_is_full(ring_buffer_t *ring_buffer);

int ring_buffer_read( ring_buffer_t* ring_buffer, uint8_t* data, uint32_t data_length, uint32_t* number_of_bytes_read );

uint32_t ring_buffer_total_size(ring_buffer_t *ring_buffer);
/**
  * @}
  */

/**
  * @}
  */


#endif // __RingBufferUtils_h__
```
